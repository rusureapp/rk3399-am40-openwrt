// SPDX-License-Identifier: GPL-2.0+
/*
 * Copyright (c) 2025 wn2t@outlook.com
 */

#include "rk3399-u-boot.dtsi"
#include "rk3399-sdram-ddr3-1600.dtsi"

&vdd_log {
	regulator-init-microvolt = <900000>;
};

&gmac {
	/delete-property/ phy-supply;
};
