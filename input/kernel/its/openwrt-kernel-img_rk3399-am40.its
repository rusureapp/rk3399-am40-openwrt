## input/kernel/its/openwrt-kernel-img_rk3399-am40.its
```
/dts-v1/;

/ {
	description = "ARM64 OpenWrt FIT (Flattened Image Tree)";
	#address-cells = <1>;

	images {
		kernel-1 {
			description = "kerneldesc";
			data = /incbin/("kernelpath");
			type = "kernel";
			arch = "arm64";
			os = "linux";
			compression = "lzma";
			load = <0x03200000>;
			entry = <0x03200000>;
			hash-1 {
				algo = "crc32";
			};
			hash-2 {
				algo = "sha1";
			};
		};

		fdt-1 {
			description = "ARM64 Linux rk3399-am40 device tree blob";
			data = /incbin/("dtbpath");
			type = "flat_dt";
			arch = "arm64";
			compression = "none";
			hash-1 {
				algo = "crc32";
			};
			hash-2 {
				algo = "sha1";
			};
		};
	};

	configurations {
		default = "config-1";

		config-1 {
			description = "OpenWrt rk3399-am40";
			kernel = "kernel-1";
			fdt = "fdt-1";
		};
	};
};
```
